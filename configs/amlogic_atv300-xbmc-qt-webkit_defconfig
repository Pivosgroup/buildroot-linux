## configs/amlogic_atv300-xbmc-qt-webkit_defconfig
```kconfig
BR2_arm=y
BR2_cortex_a9=y
BR2_KERNEL_MIRROR="git@github.com:Pivosgroup/buildroot-linux-kernel.git"
BR2_OPTIMIZE_3=y
BR2_TOOLCHAIN_EXTERNAL=y
BR2_TOOLCHAIN_EXTERNAL_CODESOURCERY_ARM2010Q1=y
BR2_EXT_TOOL_DIRS_EXTRA="/usr/lib/gconv"
# BR2_SOFT_FLOAT is not set
BR2_TARGET_OPTIMIZATION="-pipe -mfloat-abi=softfp -mfpu=neon"
BR2_TARGET_GENERIC_GETTY=y
BR2_BUSYBOX_VERSION_1_16_X=y
BR2_PACKAGE_BUSYBOX_CONFIG="board/amlogic/atv300/busybox.config"
BR2_PACKAGE_UBOOTAML=y
BR2_PACKAGE_XBMC=y
BR2_PACKAGE_QT=y
BR2_PACKAGE_QT_DEMOS=y
BR2_PACKAGE_QT_LICENSE_APPROVED=y
BR2_PACKAGE_QT_CONFIG_FILE="package/qt/qconfig-myfile.h"
BR2_PACKAGE_QT_GIF=y
BR2_PACKAGE_QT_SYSTEMJPEG=y
BR2_PACKAGE_QT_SYSTEMPNG=y
BR2_PACKAGE_QT_SYSTEMTIFF=y
BR2_PACKAGE_QT_SYSTEMZLIB=y
BR2_PACKAGE_QT_MOUSE_LINUXINPUT=y
BR2_PACKAGE_QT_KEYBOARD_LINUXINPUT=y
BR2_PACKAGE_QT_DBUS=y
BR2_PACKAGE_QT_SVG=y
BR2_PACKAGE_QT_WEBKIT=y
BR2_PACKAGE_DROPBEAR=y
BR2_PACKAGE_NANO=y
BR2_ROOTFS_SKELETON_CUSTOM=y
BR2_ROOTFS_SKELETON_CUSTOM_PATH="board/amlogic/atv300/skeleton"
BR2_LINUX_KERNEL=y
BR2_LINUX_KERNEL_CUSTOM_VERSION=y
BR2_LINUX_KERNEL_CUSTOM_VERSION_VALUE="222e45a6392331b65d8ba86bdbea78e607d2ad36"
BR2_LINUX_KERNEL_DEFCONFIG="meson_atv300"
```

## configs/amlogic_atv300-xbmc_defconfig
```kconfig
BR2_arm=y
BR2_cortex_a9=y
BR2_KERNEL_MIRROR="git@github.com:Pivosgroup/buildroot-linux-kernel.git"
BR2_OPTIMIZE_3=y
BR2_TOOLCHAIN_EXTERNAL=y
BR2_TOOLCHAIN_EXTERNAL_CODESOURCERY_ARM2010Q1=y
BR2_EXT_TOOL_DIRS_EXTRA="/usr/lib/gconv"
# BR2_SOFT_FLOAT is not set
BR2_TARGET_OPTIMIZATION="-pipe -mfloat-abi=softfp -mfpu=neon"
BR2_TARGET_GENERIC_GETTY=y
BR2_BUSYBOX_VERSION_1_17_X=y
BR2_PACKAGE_BUSYBOX_CONFIG="board/amlogic/atv300/busybox.config"
BR2_PACKAGE_UBOOTAML=y
BR2_PACKAGE_XBMC=y
BR2_PACKAGE_DOSFSTOOLS=y
BR2_PACKAGE_DOSFSTOOLS_MKDOSFS=y
BR2_PACKAGE_DOSFSTOOLS_DOSFSCK=y
BR2_PACKAGE_DOSFSTOOLS_DOSFSLABEL=y
BR2_PACKAGE_E2FSPROGS=y
BR2_PACKAGE_E2FSPROGS_UTILS=y
BR2_PACKAGE_MTD=y
BR2_PACKAGE_MTD_FLASH_OTP_DUMP=y
BR2_PACKAGE_MTD_FLASH_OTP_INFO=y
BR2_PACKAGE_NTFS_3G=y
BR2_PACKAGE_NTFSPROGS=y
BR2_PACKAGE_LIBDAEMON=y
BR2_PACKAGE_DROPBEAR=y
BR2_PACKAGE_NTP=y
BR2_PACKAGE_NTP_NTPDATE=y
BR2_PACKAGE_BASH=y
BR2_PACKAGE_IPROUTE2=y
BR2_PACKAGE_WIRELESS_TOOLS=y
BR2_PACKAGE_WIRELESS_TOOLS_LIB=y
BR2_PACKAGE_WPA_SUPPLICANT=y
BR2_PACKAGE_WPA_SUPPLICANT_CLI=y
BR2_PACKAGE_WPA_SUPPLICANT_PASSPHRASE=y
BR2_PACKAGE_WPA_SUPPLICANT_WPS=y
BR2_PACKAGE_NANO=y
BR2_ROOTFS_SKELETON_CUSTOM=y
BR2_ROOTFS_SKELETON_CUSTOM_PATH="board/amlogic/atv300/skeleton"
BR2_LINUX_KERNEL=y
BR2_LINUX_KERNEL_CUSTOM_VERSION=y
BR2_LINUX_KERNEL_CUSTOM_VERSION_VALUE="7816c2005dcdd29c6c8f79a32e234f884e900fe1"
BR2_LINUX_KERNEL_DEFCONFIG="meson_atv300"
```

## configs/amlogic_atv300_defconfig
```kconfig
BR2_arm=y
BR2_cortex_a9=y
BR2_KERNEL_MIRROR="git@github.com:Pivosgroup/buildroot-linux-kernel.git"
BR2_TOOLCHAIN_EXTERNAL=y
BR2_TOOLCHAIN_EXTERNAL_CODESOURCERY_ARM2010Q1=y
BR2_EXT_TOOL_DIRS_EXTRA="/usr/lib/gconv"
# BR2_SOFT_FLOAT is not set
BR2_TARGET_OPTIMIZATION="-pipe -mfloat-abi=softfp -mfpu=neon"
BR2_TARGET_GENERIC_GETTY=y
BR2_BUSYBOX_VERSION_1_16_X=y
BR2_PACKAGE_BUSYBOX_CONFIG="board/amlogic/atv300/busybox.config"
BR2_PACKAGE_UBOOTAML=y
BR2_ROOTFS_SKELETON_CUSTOM=y
BR2_ROOTFS_SKELETON_CUSTOM_PATH="board/amlogic/atv300/skeleton"
BR2_LINUX_KERNEL=y
BR2_LINUX_KERNEL_CUSTOM_VERSION=y
BR2_LINUX_KERNEL_CUSTOM_VERSION_VALUE="2a327dc620432e33af5c23d1cda88a4406de49c5"
BR2_LINUX_KERNEL_DEFCONFIG="meson_atv300"
```

## configs/amlogic_xios-xbmc_defconfig
```kconfig
BR2_arm=y
BR2_cortex_a9=y
BR2_KERNEL_MIRROR="git://github.com/Pivosgroup/buildroot-linux-kernel.git"
BR2_OPTIMIZE_3=y
BR2_TOOLCHAIN_EXTERNAL=y
BR2_TOOLCHAIN_EXTERNAL_CODESOURCERY_ARM2010Q1=y
BR2_PACKAGE_GDB=y
BR2_PACKAGE_GDB_SERVER=y
BR2_GDB_VERSION_7_1=y
BR2_ENABLE_LOCALE_PURGE=y
BR2_ENABLE_LOCALE_WHITELIST=""
BR2_EXT_TOOL_DIRS_EXTRA="/usr/lib/gconv /usr/share/zoneinfo"
# BR2_SOFT_FLOAT is not set
BR2_TARGET_OPTIMIZATION="-pipe -mfloat-abi=softfp -mfpu=neon"
BR2_BOARD_TYPE_AMLOGIC_M1=y
BR2_TARGET_GENERIC_GETTY=y
BR2_ROOTFS_DEVICE_CREATION_DYNAMIC_UDEV=y
BR2_ROOTFS_SKELETON_CUSTOM=y
BR2_ROOTFS_SKELETON_CUSTOM_PATH="board/amlogic/xios/skeleton"
BR2_BUSYBOX_VERSION_1_18_X=y
BR2_PACKAGE_BUSYBOX_CONFIG="board/amlogic/xios/busybox.config"
BR2_PACKAGE_BUSYBOX_SHOW_OTHERS=y
BR2_PACKAGE_UBOOTAML=y
BR2_PACKAGE_LIRC=y
BR2_PACKAGE_XBMC=y
BR2_PACKAGE_XIOS=y
BR2_PACKAGE_DOSFSTOOLS=y
BR2_PACKAGE_DOSFSTOOLS_MKDOSFS=y
BR2_PACKAGE_DOSFSTOOLS_DOSFSCK=y
BR2_PACKAGE_DOSFSTOOLS_DOSFSLABEL=y
BR2_PACKAGE_E2FSPROGS=y
BR2_PACKAGE_E2FSPROGS_UTILS=y
BR2_PACKAGE_MTD=y
BR2_PACKAGE_NTFS_3G=y
BR2_PACKAGE_NTFSPROGS=n
# BR2_PACKAGE_UDEV_MTD_PROBE is not set
BR2_PACKAGE_USBMOUNT=y
BR2_PACKAGE_MYSQL_CLIENT_LIB_ONLY=y
BR2_PACKAGE_DROPBEAR=y
BR2_PACKAGE_IPROUTE2=y
BR2_PACKAGE_NTP=y
BR2_PACKAGE_NTP_NTPDATE=y
BR2_PACKAGE_SAMBA_CIFS=n
BR2_PACKAGE_SAMBA_EVENTLOGADM=n
BR2_PACKAGE_SAMBA_NET=n
BR2_PACKAGE_SAMBA_NMBD=n
BR2_PACKAGE_SAMBA_NMBLOOKUP=n
BR2_PACKAGE_SAMBA_NTLM_AUTH=n
BR2_PACKAGE_SAMBA_PDBEDIT=n
BR2_PACKAGE_SAMBA_PROFILES=n
BR2_PACKAGE_SAMBA_RPCCLIENT=n
BR2_PACKAGE_SAMBA_SMBCACLS=n
BR2_PACKAGE_SAMBA_SMBCLIENT=n
BR2_PACKAGE_SAMBA_SMBCONTROL=n
BR2_PACKAGE_SAMBA_SMBCQUOTAS=n
BR2_PACKAGE_SAMBA_SMBD=n
BR2_PACKAGE_SAMBA_SMBGET=n
BR2_PACKAGE_SAMBA_SMBLDBTOOLS=n
BR2_PACKAGE_SAMBA_SMBPASSWD=n
BR2_PACKAGE_SAMBA_SMBSHARESEC=n
BR2_PACKAGE_SAMBA_SMBSPOOL=n
BR2_PACKAGE_SAMBA_SMBSTATUS=n
BR2_PACKAGE_SAMBA_SMBTREE=n
BR2_PACKAGE_SAMBA_SWAT=n
BR2_PACKAGE_SAMBA_SMBTAR=n
BR2_PACKAGE_SAMBA_TDB=n
BR2_PACKAGE_SAMBA_TESTPARM=n
BR2_PACKAGE_SAMBA_WINBINDD=n
BR2_PACKAGE_SAMBA_WBINFO=n
BR2_PACKAGE_WIRELESS_TOOLS=y
BR2_PACKAGE_WIRELESS_TOOLS_LIB=y
BR2_PACKAGE_WPA_SUPPLICANT=y
BR2_PACKAGE_WPA_SUPPLICANT_CLI=y
BR2_PACKAGE_WPA_SUPPLICANT_PASSPHRASE=y
BR2_PACKAGE_WPA_SUPPLICANT_WPS=y
BR2_PACKAGE_UTIL_LINUX_MOUNT=y
BR2_PACKAGE_NANO=y
# BR2_TARGET_ROOTFS_TAR is not set
BR2_TARGET_ROOTFS_RECOVERY_AML=y
BR2_TARGET_ROOTFS_RECOVERY_AML_BOARDNAME="stvm3"
BR2_LINUX_KERNEL=y
BR2_LINUX_KERNEL_CUSTOM_GIT=y
BR2_LINUX_KERNEL_CUSTOM_GIT_REPO_URL="git://github.com/Pivosgroup/buildroot-linux-kernel.git"
BR2_LINUX_KERNEL_CUSTOM_GIT_VERSION="e4430d8a0b5d7d18b112b920d2fe1a4e36397f87"
BR2_LINUX_KERNEL_VERSION="e4430d8a0b5d7d18b112b920d2fe1a4e36397f87"
BR2_LINUX_KERNEL_DEFCONFIG="meson_xios"
```

## configs/amlogic_xios_defconfig
```kconfig
BR2_arm=y
BR2_cortex_a9=y
BR2_KERNEL_MIRROR="git@github.com:Pivosgroup/buildroot-linux-kernel.git"
BR2_OPTIMIZE_3=y
BR2_TOOLCHAIN_EXTERNAL=y
BR2_TOOLCHAIN_EXTERNAL_CODESOURCERY_ARM2010Q1=y
BR2_EXT_TOOL_DIRS_EXTRA="/usr/lib/gconv"
# BR2_SOFT_FLOAT is not set
BR2_TARGET_OPTIMIZATION="-pipe -mfloat-abi=softfp -mfpu=neon"
BR2_TARGET_GENERIC_GETTY=y
BR2_BUSYBOX_VERSION_1_17_X=y
BR2_PACKAGE_BUSYBOX_CONFIG="board/amlogic/atv300/busybox.config"
BR2_PACKAGE_UBOOTAML=y
BR2_PACKAGE_DROPBEAR=y
BR2_PACKAGE_NANO=y
BR2_ROOTFS_DEVICE_CREATION_DYNAMIC_UDEV=y
BR2_ROOTFS_SKELETON_CUSTOM=y
BR2_ROOTFS_SKELETON_CUSTOM_PATH="board/amlogic/atv300/skeleton"
# BR2_TARGET_ROOTFS_TAR is not set
BR2_TARGET_ROOTFS_TAR_AML=y
BR2_LINUX_KERNEL=y
BR2_LINUX_KERNEL_CUSTOM_VERSION=y
BR2_LINUX_KERNEL_CUSTOM_VERSION_VALUE="4636e2f03d4e246188841b57bcd8fe05a9a113b7"
BR2_LINUX_KERNEL_DEFCONFIG="meson_xios"
```

## fs/recovery_aml/Config.in
```kconfig
config BR2_TARGET_ROOTFS_RECOVERY_AML
	bool "AMLogic Recovery Image"
        select BR2_TARGET_ROOTFS_TAR_AML
	help
	  Image ready for flashing via android's recovery partition


choice
        prompt "Erase Userdata"
        default BR2_TARGET_ROOTFS_RECOVERY_AML_WIPE_USERDATA_CONDITIONAL
        depends on BR2_TARGET_ROOTFS_RECOVERY_AML
        help
          Whether to wipe the userdata partition

config BR2_TARGET_ROOTFS_RECOVERY_AML_WIPE_USERDATA_CONDITIONAL
       bool "yes if previous install was not linux"

config BR2_TARGET_ROOTFS_RECOVERY_AML_WIPE_USERDATA
       bool "yes"

config BR2_TARGET_ROOTFS_RECOVERY_AML_WIPE_USERDATA_NEVER
       bool "no"

endchoice
```

## fs/tar_aml/Config.in
```kconfig
config BR2_TARGET_ROOTFS_TAR_AML
	bool "Aml-Specific tarball"
	help
	  Build a tar archive of the root filesystem

choice
        prompt "SquashFS Compression"
        depends on BR2_TARGET_ROOTFS_TAR_AML
        default BR2_TARGET_ROOTFS_SQUASHFS_TAR_AML_GZIP
        help
          Select the squashfs compression algorithm to use when
          generating the filesystem.

config BR2_TARGET_ROOTFS_SQUASHFS_TAR_AML_GZIP
       bool "gzip"

config BR2_TARGET_ROOTFS_SQUASHFS_TAR_AML_LZMA
       bool "lzma"

config BR2_TARGET_ROOTFS_SQUASHFS_TAR_AML_LZO
       bool "lzo"

endchoice
```

## package/amlogic/Config.in
```kconfig
menu "AMLogic libraries and programs"
source "package/amlogic/cmem/Config.in"
source "package/amlogic/opengl/Config.in"
source "package/amlogic/ubootaml/Config.in"
source "package/amlogic/ubootamlf16ref/Config.in"
source "package/amlogic/libamplayerm1/Config.in"
source "package/amlogic/libamplayerm3/Config.in"
source "package/amlogic/amremote_config/Config.in"
endmenu
```

## package/amlogic/amadec/Config.in
```kconfig
config BR2_PACKAGE_AMADEC
	bool "amadec"
    select BR2_PACKAGE_ALSA_LIB
	help
	  amlogic audio player.

	  http://openlinux.amlogic.com
```

## package/amlogic/amcodec/Config.in
```kconfig
config BR2_PACKAGE_AMCODEC
	bool "amcodec"
	select BR2_PACKAGE_AMADEC
	help
	  amlogic audio dsp codec.

	  http://openlinux.amlogic.com
```

## package/amlogic/amffmpeg/Config.in
```kconfig
config BR2_PACKAGE_AMFFMPEG
	bool "amffmpeg"
	select BR2_PACKAGE_ALSA_LIB
	help
	  amlogic porting for ffmpeg.

	  http://openlinux.amlogic.com
```

## package/amlogic/amljpeg/Config.in
```kconfig
config BR2_PACKAGE_AMLJPEG
	bool "amljpeg"
	help
	  amlogic hardware jpeg decoder

	  http://openlinux.amlogic.com
```

## package/amlogic/amlraw/Config.in
```kconfig
config BR2_PACKAGE_AMLRAW
	bool "amlraw"
	help
	  amlogic raw decoder

	  http://openlinux.amlogic.com
```

## package/amlogic/ampicplayer/Config.in
```kconfig
config BR2_PACKAGE_AMPICPLAYER
	bool "picture player"
	select BR2_PACKAGE_LIBPNG
	select BR2_PACKAGE_JPEG
	select BR2_PACKAGE_LIBUNGIF
	help
	  picture player
```

## package/amlogic/amplayer/Config.in
```kconfig
config BR2_PACKAGE_AMPLAYER
	bool "amplayer"
	select BR2_PACKAGE_AMFFMPEG
	select BR2_PACKAGE_ZLIB
	help
	  amlogic media player.

	  http://openlinux.amlogic.com
```

## package/amlogic/amplayer2/Config.in
```kconfig
config BR2_PACKAGE_AMPLAYER2
	bool "amplayer2"
	select BR2_PACKAGE_AMFFMPEG
	select BR2_PACKAGE_ZLIB
	help
	  amlogic media player.

	  http://openlinux.amlogic.com
```

## package/amlogic/amplayer_plugins/Config.in
```kconfig
config BR2_PACKAGE_AMPLAYER_PLUGINS
	bool "amplayer_plugins"
	select BR2_PACKAGE_AMPLAYER2
	help
	  amlogic media player control interface.

	  http://openlinux.amlogic.com
```

## package/amlogic/amremote_config/Config.in
```kconfig
config BR2_PACKAGE_AMREMOTE_CONFIG
	bool "amremote_config"
        help
          amremote_config lib
```

## package/amlogic/cmem/Config.in
```kconfig
config BR2_PACKAGE_CMEM
	bool "cmem"
	help
	  memory device operation kit for amlogic pixel device

	  http://openlinux.amlogic.com
```

## package/amlogic/if_manager/Config.in
```kconfig
config BR2_PACKAGE_IF_MANAGER
	bool "if_manager"
	help
	  if_manager lib

	  http://openlinux.amlogic.com
```

## package/amlogic/kplayer/Config.in
```kconfig
config BR2_PACKAGE_KPLAYER
	bool "kplayer"
	select BR2_PACKAGE_AMADEC
	select BR2_PACKAGE_AMCODEC
	select BR2_PACKAGE_AMFFMPEG
	select BR2_PACKAGE_AMPLAYER
	help
	  amlogic kplayer.

	  http://openlinux.amlogic.com
```

## package/amlogic/libamplayer/Config.in
```kconfig
config BR2_PACKAGE_LIBAMPLAYER
        bool "libamplayer"
        help
          amlogic media player library.

          http://openlinux.amlogic.com
```

## package/amlogic/libamplayerm1/Config.in
```kconfig
config BR2_PACKAGE_LIBAMPLAYERM1
	depends on BR2_BOARD_TYPE_AMLOGIC_M1
        bool "libamplayerm1"
        help
          amlogic media player library for M1.

          http://openlinux.amlogic.com
```

## package/amlogic/libamplayerm3/Config.in
```kconfig
config BR2_PACKAGE_LIBAMPLAYERM3
	depends on BR2_BOARD_TYPE_AMLOGIC_M3
        bool "libamplayerm3"
        help
          amlogic media player library for M3.

          http://openlinux.amlogic.com
```

## package/amlogic/libbttv/Config.in
```kconfig
config BR2_PACKAGE_LIBBTTV
	bool "libbttv"
	depends on BR2_PACKAGE_LIBXFER
	depends on BR2_PACKAGE_QT
        help
          bttv lib
```
