## package/thirdparty/librtmp/Config.in
```kconfig
config BR2_PACKAGE_LIBRTMP
        bool "librtmp"
	help
	  librtmp - RTMPDump Real-Time Messaging Protocol API
```

## package/thirdparty/libshairport/Config.in
```kconfig
config BR2_PACKAGE_LIBSHAIRPORT
        bool "libshairport"
        help
          LIBSHAIRPORT is a client library that emulates an airplay server
```

## package/thirdparty/libssh2/Config.in
```kconfig
config BR2_PACKAGE_LIBSSH2
	bool "libssh2"
	help
	  A client-side C library implementing the SSH2 protocol.

	  http://www.libssh2.org/
```

## package/thirdparty/libudev/Config.in
```kconfig
config BR2_PACKAGE_LIBUDEV
	bool "libudev"
	help
	  UDEV Interface

	  https://www.kernel.org/pub/linux/utils/kernel/hotplug/libudev/
```

## package/thirdparty/lirc/Config.in
```kconfig
config BR2_PACKAGE_LIRC
        bool "lirc"
        help
          Linux Remote Control Driver/Daemon
```

## package/thirdparty/recovery_reboot/Config.in
```kconfig
config BR2_PACKAGE_RECOVERY_REBOOT
	bool "recovery_reboot"
        help
          Reboot normally or into recovery
```

## package/thirdparty/samba30/Config.in
```kconfig
config BR2_PACKAGE_SAMBA30
	bool "samba 3.0"
	select BR2_PACKAGE_LIBICONV if !BR2_ENABLE_LOCALE
	help
	  Provides print services to all manner of SMB/CIFS clients,
	  including the numerous versions of Microsoft Windows
	  operating systems.

	  http://www.samba.org/

	  NOTE: A complete Samba install takes over 50MB of space,
		so choose only the components you need.

config BR2_PACKAGE_SAMBA30_AVAHI
	bool "support avahi"
	default y
	depends on BR2_PACKAGE_SAMBA30
	depends on BR2_PACKAGE_AVAHI_DAEMON
	depends on BR2_PACKAGE_DBUS
	help
	  Include support for avahi

comment "support avahi - disabled (requires avahi-daemon/dbus)"
	depends on !BR2_PACKAGE_AVAHI_DAEMON || !BR2_PACKAGE_DBUS
```

## package/thirdparty/tvheadend/Config.in
```kconfig
config BR2_PACKAGE_TVHEADEND
	bool "tvheadend"
	help
	  Web-based PVR.

config BR2_PACKAGE_TVHEADEND_AVAHI
        bool "support avahi"
        default y
        depends on BR2_PACKAGE_TVHEADEND
        depends on BR2_PACKAGE_AVAHI_DAEMON
        help
          Include support for avahi
```

## package/thirdparty/xbmc/Config.in
```kconfig
config BR2_PACKAGE_XBMC
	bool "xbmc"
	select BR2_PACKAGE_AMREMOTE_CONFIG
	select BR2_PACKAGE_KPLAYER
	select BR2_PACKAGE_ALSA_UTILS
	select BR2_PACKAGE_ALSA_UTILS_ALSAMIXER
	select BR2_PACKAGE_FLAC
	select BR2_PACKAGE_LIBASS
	select BR2_PACKAGE_LIBMAD
	select BR2_PACKAGE_LIBMPEG2
	select BR2_PACKAGE_LIBOGG
	select BR2_PACKAGE_LIBSAMPLERATE
	select BR2_PACKAGE_LIBTHEORA
	select BR2_PACKAGE_LIBVORBIS
	select BR2_PACKAGE_WAVPACK
	select BR2_PACKAGE_BZIP2
	select BR2_PACKAGE_DBUS
	select BR2_PACKAGE_LIBCDIO
	select BR2_PACKAGE_PYTHON
	select BR2_PACKAGE_PYTHON_BZIP2
	select BR2_PACKAGE_PYTHON_BSDDB
	select BR2_PACKAGE_PYTHON_CURSES
	select BR2_PACKAGE_PYTHON_PYEXPAT
	select BR2_PACKAGE_PYTHON_READLINE
	select BR2_PACKAGE_PYTHON_SSL
	select BR2_PACKAGE_PYTHON_UNICODEDATA
	select BR2_PACKAGE_PYTHON_SQLITE
	select BR2_PACKAGE_PYTHON_ZLIB
	select BR2_PACKAGE_LZO
	select BR2_PACKAGE_ZLIB
	select BR2_PACKAGE_LIBGCRYPT
	select BR2_PACKAGE_OPENSSL
	select BR2_PACKAGE_MYSQL_CLIENT
	select BR2_PACKAGE_SQLITE
	select BR2_PACKAGE_FONTCONFIG
	select BR2_PACKAGE_FREETYPE
	select BR2_PACKAGE_JASPER
	select BR2_PACKAGE_JPEG
	select BR2_PACKAGE_LIBMODPLUG
	select BR2_PACKAGE_LIBPNG
	select BR2_PACKAGE_LIBUNGIF
	select BR2_PACKAGE_TIFF
	select BR2_PACKAGE_LIBCURL
	select BR2_PACKAGE_LIBMICROHTTPD
	select BR2_PACKAGE_LIBSSH2
	select BR2_PACKAGE_BOOST
	select BR2_PACKAGE_BOOST_THREAD
	select BR2_PACKAGE_FRIBIDI
	select BR2_PACKAGE_NCURSES
	select BR2_PACKAGE_NCURSES_TARGET_PANEL
	select BR2_PACKAGE_NCURSES_TARGET_FORM
	select BR2_PACKAGE_NCURSES_TARGET_MENU
	select BR2_PACKAGE_PCRE
	select BR2_PACKAGE_READLINE
	select BR2_PACKAGE_EXPAT
	select BR2_PACKAGE_LIBXML2
	select BR2_PACKAGE_YAJL
	select BR2_PACKAGE_SAMBA30
	select BR2_PACKAGE_SAMBA30_LIBSMBCLIENT
	select BR2_PACKAGE_LIBNFS
	select BR2_PACKAGE_LIBRTMP
	select BR2_PACKAGE_AFPFS_NG
	select BR2_PACKAGE_LIBBLURAY
	select BR2_PACKAGE_LIBPLIST
	select BR2_PACKAGE_LIBSHAIRPORT
	select BR2_PACKAGE_AVAHI
	select BR2_PACKAGE_AVAHI_DAEMON
	select BR2_PACKAGE_NCURSES_TARGET_PANEL
	select BR2_PACKAGE_NCURSES_TARGET_FORM
	select BR2_PACKAGE_NCURSES_TARGET_MENU
	select BR2_PACKAGE_OPENGL
	select BR2_PACKAGE_LIBUSB
	select BR2_PACKAGE_LIBUSB_COMPAT
        select BR2_PACKAGE_TINYXML
	help
	xbmc

		http://xbmc.org
```

## package/thirdparty/xbmcpvr/Config.in
```kconfig
config BR2_PACKAGE_XBMCPVR
	bool "xbmcpvr"
	help
	  XBMC PVR Addons
 depends on BR2_PACKAGE_XBMC
```

## package/thirdparty/xios-skin/Config.in
```kconfig
config BR2_PACKAGE_XIOS_SKIN
depends on BR2_PACKAGE_XBMC
        bool "XIOS Skin"
```

## package/udev/Config.in
```kconfig
config BR2_PACKAGE_UDEV
	bool "udev"
	depends on BR2_ROOTFS_DEVICE_CREATION_DYNAMIC_UDEV
	help
	  Userspace device daemon.

	  ftp://ftp.kernel.org/pub/linux/utils/kernel/hotplug/

if BR2_PACKAGE_UDEV

config BR2_PACKAGE_UDEV_MTD_PROBE
	bool "Install mtd_probe callout"
	default y
	help
	  mtd_probe - udev callout to probe mtd devices

config BR2_PACKAGE_UDEV_ALL_EXTRAS
	bool "enable all extras"
	depends on BR2_LARGEFILE # acl
	depends on BR2_USE_WCHAR # libglib2
	depends on BR2_PROGRAM_INVOCATION # usbutils
	select BR2_PACKAGE_ACL
	select BR2_PACKAGE_LIBUSB
	select BR2_PACKAGE_LIBUSB_COMPAT
	select BR2_PACKAGE_USBUTILS
	select BR2_PACKAGE_HWDATA
	select BR2_PACKAGE_LIBGLIB2
	help
	  Enable all extras with external dependencies like
	  libacl, libusb, libusb-compat, usbutils, hwdata

comment "udev extras requires a toolchain with LARGEFILE/WCHAR/PROGRAM_INVOCATION support"
	depends on !(BR2_LARGEFILE && BR2_USE_WCHAR && BR2_PROGRAM_INVOCATION)

endif

comment "udev requires /dev mgmnt set to udev under System configuration"
	depends on !BR2_ROOTFS_DEVICE_CREATION_DYNAMIC_UDEV
```

## target/device/Amlogic/Config.in
```kconfig
menuconfig BR2_TARGET_AMLOGIC
	bool "Amlogic Device Support"	


source "target/device/Amlogic/root/Config.in"
```
