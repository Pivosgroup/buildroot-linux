## package/amlogic/libimecore/Config.in
```kconfig
config BR2_PACKAGE_LIBIMECORE
	bool "libimecore"
	help
	  imeT9 cor lib

	  http://openlinux.amlogic.com
```

## package/amlogic/libplayer/Config.in
```kconfig
config BR2_PACKAGE_LIBPLAYER
        bool "libplayer"
        help
          amlogic media player library.

          http://openlinux.amlogic.com
```

## package/amlogic/libxfer/Config.in
```kconfig
config BR2_PACKAGE_LIBXFER
	bool "libxfer"
	select BR2_PACKAGE_ZLIB
	select BR2_PACKAGE_CURL
	help
	 xfer lib
```

## package/amlogic/opengl/Config.in
```kconfig
config BR2_PACKAGE_OPENGL
	bool "opengl"
	help
	  amlogic mali400 opengl driver.

	  http://openlinux.amlogic.com
```

## package/amlogic/ubootaml/Config.in
```kconfig
config BR2_PACKAGE_UBOOTAML
	bool "ubootaml"
	help
	  uBoot from AMLogic's Android repo

	  http://openlinux.amlogic.com
```

## package/amlogic/ubootf16ref/Config.in
```kconfig
config BR2_PACKAGE_UBOOTF16REF
	bool "ubootf16ref"
	help
	  uBoot from AMLogic's latest repo

	  http://openlinux.amlogic.com
```

## package/amlogic/xbmc/Config.in
```kconfig
config BR2_PACKAGE_XBMC
	bool "xbmc (deps only)"
	select BR2_PACKAGE_KPLAYER
	select BR2_PACKAGE_OPENGL
	select BR2_PACKAGE_LZO
	select BR2_PACKAGE_NCURSES
	select BR2_PACKAGE_ALSA_UTILS
	select BR2_PACKAGE_ALSA_UTILS_ALSAMIXER
	help
		XBMC
```

## package/mysql_client/Config.in
```kconfig
config BR2_PACKAGE_MYSQL_CLIENT
	bool "MySQL client"
	depends on BR2_INSTALL_LIBSTDCPP
	select BR2_PACKAGE_NCURSES
	select BR2_PACKAGE_READLINE
	help
	  MySQL client

config BR2_PACKAGE_MYSQL_CLIENT_LIB_ONLY
	bool "Install client library only"
	default n
	depends on BR2_PACKAGE_MYSQL_CLIENT

comment "Mysql client requires a toolchain with C++ support enabled"
	depends on !BR2_INSTALL_LIBSTDCPP
```

## package/thirdparty/Config.in
```kconfig
menu "XBMC and its Dependencies"
source "package/thirdparty/bluez_utils/Config.in"
source "package/thirdparty/boost/Config.in"
source "package/thirdparty/fribidi/Config.in"
source "package/thirdparty/jasper/Config.in"
source "package/thirdparty/libass/Config.in"
source "package/thirdparty/libcdio/Config.in"
source "package/thirdparty/libcec/Config.in"
source "package/thirdparty/libenca/Config.in"
source "package/thirdparty/libmodplug/Config.in"
source "package/thirdparty/libnfs/Config.in"
source "package/thirdparty/libbluray/Config.in"
source "package/thirdparty/libplist/Config.in"
source "package/thirdparty/libshairport/Config.in"
source "package/thirdparty/libssh/Config.in"
source "package/thirdparty/lirc/Config.in"
source "package/thirdparty/afpfs-ng/Config.in"
source "package/thirdparty/librtmp/Config.in"
source "package/thirdparty/libssh2/Config.in"
source "package/thirdparty/recovery_reboot/Config.in"
source "package/thirdparty/samba30/Config.in"
source "package/thirdparty/taglib18/Config.in"
source "package/thirdparty/tinyxml/Config.in"
source "package/thirdparty/tvheadend/Config.in"
source "package/thirdparty/v4lutils/Config.in"
source "package/thirdparty/yajl/Config.in"
source "package/thirdparty/xbmc/Config.in"
source "package/thirdparty/xbmcpvr/Config.in"
source "package/thirdparty/xios-skin/Config.in"
source "package/thirdparty/boblight/Config.in"
source "package/thirdparty/libgphoto2/Config.in"

endmenu
```

## package/thirdparty/afpfs-ng/Config.in
```kconfig
config BR2_PACKAGE_AFPFS_NG
        bool "afpfs-ng"
        help
          AFPFS_NG is a client library for accessing AFP shares over a network
```

## package/thirdparty/boblight/Config.in
```kconfig
config BR2_PACKAGE_BOBLIGHT
	bool "boblight"
	help
	boblight

		http://code.google.com/p/boblight/
config BR2_PACKAGE_BOBLIGHT_LIBUSB
	bool "Enable libusb support (iBeLight)"
	select BR2_PACKAGE_LIBUSB
	default y
```

## package/thirdparty/boost/Config.in
```kconfig
config BR2_PACKAGE_BOOST
	bool "boost"
	depends on BR2_INSTALL_LIBSTDCPP
	help
	  A well-knownd C++ library
	  http://www.boost.org

menu "Boost library selection"
        depends on BR2_PACKAGE_BOOST

config BR2_PACKAGE_BOOST_DATETIME
	bool "enable date_time library"
	default n

config BR2_PACKAGE_BOOST_FILESYSTEM
	bool "enable filesystem library"
	default n

config BR2_PACKAGE_BOOST_GRAPH
	bool "enable graph library"
	default n

config BR2_PACKAGE_BOOST_GRAPH_PARALLEL
	bool "enable graph_parallel library"
	default n

config BR2_PACKAGE_BOOST_IOSTREAMS
	bool "enable iostreams library"
	select BR2_PACKAGE_ZLIB
	select BR2_PACKAGE_BZIP2
	default n

config BR2_PACKAGE_BOOST_MATH
	bool "enable math library"
	default n

config BR2_PACKAGE_BOOST_MPI
	bool "enable mpi library"
	default n

config BR2_PACKAGE_BOOST_PROGRAM_OPTIONS
	bool "enable program_options library"
	default n

config BR2_PACKAGE_BOOST_PYTHON
	bool "enable python library"
	select BR2_PACKAGE_PYTHON
	default n

config BR2_PACKAGE_BOOST_RANDOM
	bool "enable random library"
	default n

config BR2_PACKAGE_BOOST_REGEX
	bool "enable regex library"
	default n

config BR2_PACKAGE_BOOST_SERIALIZATION
	bool "enable serialization library"
	default n

config BR2_PACKAGE_BOOST_SIGNALS
	bool "enable signals library"
	default n

config BR2_PACKAGE_BOOST_SYSTEM
	bool "enable system library"
	default n

config BR2_PACKAGE_BOOST_TEST
	bool "enable test library"
	default n

config BR2_PACKAGE_BOOST_THREAD
	bool "enable thread library"
	default n

config BR2_PACKAGE_BOOST_WAVE
	bool "enable wave library"
	default n
endmenu
```

## package/thirdparty/fribidi/Config.in
```kconfig
config BR2_PACKAGE_FRIBIDI
       bool "fribidi"
       help
         Free Implementation of the Unicode BiDi algorithm for Hebrew and/or Arabic languages.

         http://fribidi.org/download
```

## package/thirdparty/gphotofs/Config.in
```kconfig
config BR2_PACKAGE_GPHOTOFS
	bool "gphotofs"
        select BR2_PACKAGE_LIBUSB-COMPAT
        select BR2_PACKAGE_LIBGPHOTO2
	select BR2_PACKAGE_FUSE
  	help
	  gphotofs   

	  http://www.gphoto.org
```

## package/thirdparty/joe/Config.in
```kconfig
config BR2_PACKAGE_JOE
	bool "joe"
	help
	  Joe's Own Editor.

	  http://joe-editor.sourceforge.net
```

## package/thirdparty/libass/Config.in
```kconfig
config BR2_PACKAGE_LIBASS
	bool "libass"
	depends on BR2_PACKAGE_FREETYPE
	depends on BR2_PACKAGE_FONTCONFIG
	select BR2_PACKAGE_LIBENCA
	help
	  libass is a portable subtitle renderer for the ASS/SSA (Advanced Substation Alpha/Substation Alpha) subtitle format

	  http://code.google.com/p/libass/
```

## package/thirdparty/libbluray/Config.in
```kconfig
config BR2_PACKAGE_LIBBLURAY
        bool "libbluray"
        help
          LIBBLURAY is a client library for accessing bluray disks.

          http://www.videolan.org/developers/libbluray.html
```

## package/thirdparty/libcdio/Config.in
```kconfig
config BR2_PACKAGE_LIBCDIO
	bool "libcdio"
	help
	  The GNU Compact Disc Input and Control library.

	  http://www.gnu.org/software/libcdio/
```

## package/thirdparty/libcec/Config.in
```kconfig
config BR2_PACKAGE_LIBCEC
        bool "libcec"
        help
          LIBCEC is a client library for hdmi cec device control.

          https://github.com/Pulse-Eight/libcec.git
```

## package/thirdparty/libenca/Config.in
```kconfig
config BR2_PACKAGE_LIBENCA
       bool "enca"
       help
         Extremely Naive Charset Analyser.

         http://cihar.com/software/enca/
```

## package/thirdparty/libgphoto2/Config.in
```kconfig
config BR2_PACKAGE_LIBGPHOTO2
	bool "libgphoto2"
        select BR2_PACKAGE_LIBUSB-COMPAT
	help
	  libgphoto2   

	  http://www.gphoto.org
```

## package/thirdparty/libmodplug/Config.in
```kconfig
config BR2_PACKAGE_LIBMODPLUG
	bool "libmodplug"
	depends on BR2_INSTALL_LIBSTDCPP
	help
	  MOD music file decoder.

	  http://modplug-xmms.sourceforge.net/
```

## package/thirdparty/libnfs/Config.in
```kconfig
config BR2_PACKAGE_LIBNFS
        bool "libnfs"
        help
          LIBNFS is a client library for accessing NFS shares over a network.

          https://github.com/sahlberg/libnfs
```

## package/thirdparty/libplist/Config.in
```kconfig
config BR2_PACKAGE_LIBPLIST
        bool "libplist"
        depends on BR2_PACKAGE_LIBXML2
        help
          LIBPLIST is a client for manipulating Apple Property List (.plist) files

          http://cgit.sukimashita.com/libplist.git
```
